## layers/meta-jukebox/conf/layer.conf
```bitbake
# This is the DI card of my custom layer
# We have a conf and classes directory, add to BBPATH
BBPATH .= ":${LAYERDIR}"

# We have recipes-* directories, add to BBFILES
BBFILES += "${LAYERDIR}/recipes-*/*/*.bb \
            ${LAYERDIR}/recipes-*/*/*.bbappend"

BBFILE_COLLECTIONS += "meta-jukebox"
BBFILE_PATTERN_meta-jukebox = "^${LAYERDIR}/"
BBFILE_PRIORITY_meta-jukebox = "10"

LAYERDEPENDS_meta-jukebox = "core"
LAYERSERIES_COMPAT_meta-jukebox = "scarthgap"
```
